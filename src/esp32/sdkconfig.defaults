## src/esp32/sdkconfig.defaults
```kconfig
CONFIG_IDF_TARGET="esp32s3"
CONFIG_ESPTOOLPY_FLASHMODE_DIO=y
CONFIG_ESPTOOLPY_FLASHFREQ_80M=y
CONFIG_ESPTOOLPY_FLASHSIZE_16MB=y
CONFIG_ESP_CONSOLE_UART_DEFAULT=y
CONFIG_ESP_CONSOLE_SECONDARY_NONE=y
CONFIG_ESP_CONSOLE_UART_BAUDRATE=115200
CONFIG_ESPTOOLPY_MONITOR_BAUD=115200
CONFIG_ESP_MAIN_TASK_STACK_SIZE=8192

# POPULAR-3 BLE central; reference library transport, README RAM/UART flow.
CONFIG_BT_ENABLED=y
CONFIG_BT_BLUEDROID_ENABLED=y
CONFIG_BT_BLE_ENABLED=y
CONFIG_BT_GATTC_ENABLE=y
CONFIG_BT_GATTS_ENABLE=y
CONFIG_BT_BLE_42_FEATURES_SUPPORTED=y
CONFIG_BT_BLE_42_SCAN_EN=y
# CONFIG_BT_BLE_50_FEATURES_SUPPORTED is not set

# Only BLE is selected from the reference Arduino component; no SD/TF app.
CONFIG_FREERTOS_HZ=1000
# CONFIG_AUTOSTART_ARDUINO is not set
CONFIG_ARDUINO_VARIANT="esp32s3"
CONFIG_ARDUINO_SELECTIVE_COMPILATION=y
# CONFIG_ARDUINO_SELECTIVE_SPI is not set
# CONFIG_ARDUINO_SELECTIVE_Wire is not set
# CONFIG_ARDUINO_SELECTIVE_ESP_SR is not set
# CONFIG_ARDUINO_SELECTIVE_EEPROM is not set
CONFIG_ARDUINO_SELECTIVE_Preferences=y
# CONFIG_ARDUINO_SELECTIVE_Ticker is not set
# CONFIG_ARDUINO_SELECTIVE_Update is not set
# CONFIG_ARDUINO_SELECTIVE_Zigbee is not set
# CONFIG_ARDUINO_SELECTIVE_FS is not set
# CONFIG_ARDUINO_SELECTIVE_SD is not set
# CONFIG_ARDUINO_SELECTIVE_SD_MMC is not set
# CONFIG_ARDUINO_SELECTIVE_SPIFFS is not set
# CONFIG_ARDUINO_SELECTIVE_FFat is not set
# CONFIG_ARDUINO_SELECTIVE_LittleFS is not set
# CONFIG_ARDUINO_SELECTIVE_Network is not set
# CONFIG_ARDUINO_SELECTIVE_Ethernet is not set
# CONFIG_ARDUINO_SELECTIVE_PPP is not set
# CONFIG_ARDUINO_SELECTIVE_Hash is not set
# CONFIG_ARDUINO_SELECTIVE_ArduinoOTA is not set
# CONFIG_ARDUINO_SELECTIVE_AsyncUDP is not set
# CONFIG_ARDUINO_SELECTIVE_DNSServer is not set
# CONFIG_ARDUINO_SELECTIVE_ESPmDNS is not set
# CONFIG_ARDUINO_SELECTIVE_HTTPClient is not set
# CONFIG_ARDUINO_SELECTIVE_Matter is not set
# CONFIG_ARDUINO_SELECTIVE_NetBIOS is not set
# CONFIG_ARDUINO_SELECTIVE_WebServer is not set
# CONFIG_ARDUINO_SELECTIVE_WiFi is not set
# CONFIG_ARDUINO_SELECTIVE_NetworkClientSecure is not set
# CONFIG_ARDUINO_SELECTIVE_WiFiProv is not set
CONFIG_ARDUINO_SELECTIVE_BLE=y
# CONFIG_ARDUINO_SELECTIVE_BluetoothSerial is not set
# CONFIG_ARDUINO_SELECTIVE_SimpleBLE is not set
# CONFIG_ARDUINO_SELECTIVE_RainMaker is not set
# CONFIG_ARDUINO_SELECTIVE_OpenThread is not set
# CONFIG_ARDUINO_SELECTIVE_Insights is not set

# Raw PCM needs 330750 contiguous bytes. Configure PSRAM only for the confirmed module type.
# No guessed flash/PSRAM electrical mode added by this offline port.

# CONFIG_ARDUINO_SELECTIVE_Console is not set

# CONFIG_ARDUINO_SELECTIVE_ESP_I2S is not set

# CONFIG_ARDUINO_SELECTIVE_ESP_NOW is not set

# CONFIG_ARDUINO_SELECTIVE_ESP_HostedOTA is not set

# CONFIG_ARDUINO_SELECTIVE_HTTPUpdate is not set

# CONFIG_ARDUINO_SELECTIVE_USB is not set
```
